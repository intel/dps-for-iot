## dps-micro/zephyr/sample.yaml
```yaml
sample:
  description: Zephyr port of DPS
  name: dps_app
common:
    tags: DPS
    harness: console
    harness_config:
      type: one_line
      regex:
        - "Hello World! (.*)"
tests:
  sample.helloworld:
    tags: DPS
```
